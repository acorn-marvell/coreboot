## src/mainboard/google/cyclone/Kconfig
```kconfig
##
## This file is part of the coreboot project.
##
## Copyright 2015 Google Inc.
##
## This program is free software; you can redistribute it and/or modify
## it under the terms of the GNU General Public License as published by
## the Free Software Foundation; version 2 of the License.
##
## This program is distributed in the hope that it will be useful,
## but WITHOUT ANY WARRANTY; without even the implied warranty of
## MERCHANTABILITY or FITNESS FOR A PARTICULAR PURPOSE.  See the
## GNU General Public License for more details.
##
## You should have received a copy of the GNU General Public License
## along with this program; if not, write to the Free Software
## Foundation, Inc.
##

if BOARD_GOOGLE_CYCLONE

config BOARD_SPECIFIC_OPTIONS # dummy
	def_bool y
	select SOC_MARVELL_ARMADA38X
	select BOARD_ID_AUTO
	select BOARD_ROMSIZE_KB_8192
	select COMMON_CBFS_SPI_WRAPPER
	select HAVE_HARD_RESET
	select MAINBOARD_HAS_CHROMEOS
	select SPI_FLASH
	select SPI_FLASH_WINBOND
	select MAINBOARD_HAS_BOOTBLOCK_INIT
	select CHROMEOS_VBNV_FLASH

config MAINBOARD_DIR
	string
	default google/cyclone

config MAINBOARD_PART_NUMBER
	string
	default "Cyclone"

config DRAM_SIZE_MB
	int
	default 512

config BOOT_MEDIA_SPI_BUS
	int
	default 1

config DRIVER_TPM_I2C_BUS
	hex
	default 0x1

config DRIVER_TPM_I2C_ADDR
	hex
	default 0x20

endif # BOARD_MARVELL_CYCLONE
```

## src/mainboard/marvell/acorn/Kconfig
```kconfig
##
## This file is part of the coreboot project.
##
## Copyright 2015 Marvell ltd.
##
## This program is free software; you can redistribute it and/or modify
## it under the terms of the GNU General Public License as published by
## the Free Software Foundation; version 2 of the License.
##
## This program is distributed in the hope that it will be useful,
## but WITHOUT ANY WARRANTY; without even the implied warranty of
## MERCHANTABILITY or FITNESS FOR A PARTICULAR PURPOSE.  See the
## GNU General Public License for more details.
##
## You should have received a copy of the GNU General Public License
## along with this program; if not, write to the Free Software
## Foundation, Inc., 51 Franklin St, Fifth Floor, Boston, MA 02110-1301 USA
##

if BOARD_MARVELL_ACORN

config BOARD_SPECIFIC_OPTIONS # dummy
	def_bool y
	select CHROMEOS
	select EC_SOFTWARE_SYNC
	select SOC_MARVELL_ARMADA38X
	select MAINBOARD_HAS_BOOTBLOCK_INIT
	select SPI_FLASH
	select VIRTUAL_DEV_SWITCH

config MAINBOARD_DIR
	string
	default marvell/acorn

config MAINBOARD_PART_NUMBER
	string
	default "Acorn"

config DRAM_DMA_START
	hex
	default 0x00000000

config DRAM_DMA_SIZE
	hex
	default 0x40000000

config VBOOT_RAMSTAGE_INDEX
	hex
	default 0x2

config FLASHMAP_OFFSET
	hex
	default 0x00100000

endif # BOARD_MARVELL_ACORN
```

## src/soc/marvell/armada38x/Kconfig
```kconfig
config SOC_MARVELL_ARMADA38X
	bool
	default n
	select HAVE_UART_MEMORY_MAPPED
	select HAVE_UART_SPECIAL
	select BOOTBLOCK_CONSOLE
	select EARLY_CONSOLE
	select DYNAMIC_CBMEM
	select ARM_BOOTBLOCK_CUSTOM
	select ARCH_BOOTBLOCK_ARM_V4
	select ARCH_VERSTAGE_ARM_V7
	select ARCH_ROMSTAGE_ARM_V7
	select ARCH_RAMSTAGE_ARM_V7

if SOC_MARVELL_ARMADA38X

config BOOTBLOCK_CPU_INIT
	string
	default "soc/marvell/armada38x/bootblock.c"
	help
	  CPU/SoC-specific bootblock code. This is useful if the
	  bootblock must load microcode or copy data from ROM before
	  searching for the bootblock.

config BOOTBLOCK_BASE
	hex
	default 0x00000000

config CONSOLE_SERIAL_UART_ADDRESS
	hex
	depends on CONSOLE_SERIAL_UART
        default 0xf1012000

endif
```
